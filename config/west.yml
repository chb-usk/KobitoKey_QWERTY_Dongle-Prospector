## config/west.yml
```yaml
manifest:
  defaults:
    revision: main
  remotes:
    - name: zmkfirmware
      url-base: https://github.com/zmkfirmware
    - name: badjeff
      url-base: https://github.com/badjeff
    - name: hsgw
      url-base: https://github.com/hsgw
    - name: caksoylar  # <-- led
      url-base: https://github.com/caksoylar
    - name: carrefinho  # <-- Prospector dongle
      url-base: https://github.com/carrefinho  

  projects:
    # ZMK 本体。公式の app/west.yml を取り込む
    - name: zmk
      remote: zmkfirmware
      import: app/west.yml

    # PMW3610 ドライバ（外部モジュール）
    # zmk-0.4 ブランチ: Zephyr 4.1対応、compatible → pixart,pmw3610-alt
    - name: zmk-pmw3610-driver
      remote: badjeff
      revision: zmk-0.4
      # 置き場所を明示したい場合は path を指定（任意）
      # path: modules/zmk-pmw3610-driver
    
    # Sensor-rotation
    - name: zmk-feature-sensor_rotation
      remote: hsgw
      revision: main

    # LED
    - name: zmk-rgbled-widget  # <-- led
      remote: caksoylar
      revision: main

    # Prospector dongle module (display and adapter)
    # Using upstream Zephyr 4.1 compatible branch.
    # Original: https://github.com/carrefinho/prospector-zmk-module
    # TODO: upstream core/zephyr-4-1 branch still has the 'A' display bug
    #   (uses "N/A" in battery_bar.c which renders as "A" on display).
    #   Need to apply fix from happy-ryo/prospector-zmk-module
    #   fix/battery-bar-display-A-character branch once rebased onto
    #   core/zephyr-4-1, then switch back to the fork.
    - name: prospector-zmk-module
      remote: carrefinho
      revision: core/zephyr-4-1

  self:
    path: config
```
